## boards/shields/half-plank-left/Kconfig.defconfig
```kconfig
if SHIELD_HALF_PLANK_LEFT

# Name must be less than 16 characters long!
config ZMK_KEYBOARD_NAME
    default "Half Plank"

config ZMK_SPLIT_ROLE_CENTRAL
    default y

endif

if SHIELD_HALF_PLANK_LEFT || SHIELD_HALF_PLANK_RIGHT

config ZMK_SPLIT
    default y

endif
```

## boards/shields/half-plank/Kconfig.shield
```kconfig
# No whitespace after the comma or in your part name!
config SHIELD_HALF_PLANK_LEFT
    def_bool $(shields_list_contains,half_plank_left)

# No whitespace after the comma or in your part name!
config SHIELD_HALF_PLANK_RIGHT
    def_bool $(shields_list_contains,half_plank_right)
```
